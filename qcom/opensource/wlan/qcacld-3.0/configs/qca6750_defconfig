## qcom/opensource/wlan/qcacld-3.0/configs/qca6750_defconfig
```kconfig
CONFIG_CNSS_QCA6750 := y
include $(WLAN_ROOT)/configs/default_defconfig

#Enable Constrained Application Protocol feature
CONFIG_WLAN_FEATURE_COAP := y
```
